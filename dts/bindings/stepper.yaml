## dts/bindings/stepper.yaml
```yaml
compatible: "stepper"
description: Stepper Motor driver
include: base.yaml

properties:
  pwms:
    required: true
    type: phandle-array
    description: PWM for steps of stepper 
  
  dir-gpios:
    required: true
    type: phandle-array
    description: direcction_pin
  
  limit-gpios:
    required: true
    type: phandle-array
    description: limit_switches
    


  
```
